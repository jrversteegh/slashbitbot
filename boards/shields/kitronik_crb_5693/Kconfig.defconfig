## boards/shields/kitronik_crb_5693/Kconfig.defconfig
```kconfig
# Copyright (c) 2023 Jaap Versteegh <j.r.versteegh@gmail.com>

if SHIELD_KITRONIK_CRB_5693

config PWM
        default y
config PWM_PCA9685 
        default y

endif
```

## boards/shields/kitronik_crb_5693/Kconfig.shield
```kconfig
# Copyright (c) 2023 Jaap Versteegh <j.r.versteegh@gmail.com>                                                  
# SPDX-License-Identifier: Apache-2.0                                                                
                                                                                                     
config SHIELD_KITRONIK_CRB_5693                                                                       
        def_bool $(shields_list_contains,kitronik_crb_5693) 
```

## boards/shields/kitronik_crb_5693/dts/bindings/pwm-motors.yaml
```yaml
# Copyright (c) 2023 Jaap Versteegh <j.r.versteegh@gmail.com>
# SPDX-License-Identifier: Apache-2.0

description: PWM-driven motors.

compatible: "pwm-motors"

child-binding:
  description: Individual motor
  properties:
    pwms:
      required: true
      type: phandle-array
      description: PWM specifiers (forward and backward) driving the motor.
```

## boards/shields/kitronik_crb_5693/dts/bindings/pwm-servos.yaml
```yaml
# Copyright (c) 2022 Nordic Semiconductor ASA
# SPDX-License-Identifier: Apache-2.0

description: PWM-driven servo motors.

compatible: "pwm-servos"

child-binding:
  description: Individual servo
  properties:
    pwms:
      required: true
      type: phandle-array
      description: PWM specifier driving the servo motor.

    min-pulse:
      required: true
      type: int
      description: Minimum pulse width (nanoseconds).

    max-pulse:
      required: true
      type: int
      description: Maximum pulse width (nanoseconds).
```
